/* Copyright (c) 2015-2016, The Linux Foundation. All rights reserved.
 *
 * This program is free software; you can redistribute it and/or modify
 * it under the terms of the GNU General Public License version 2 and
 * only version 2 as published by the Free Software Foundation.
 *
 * This program is distributed in the hope that it will be useful,
 * but WITHOUT ANY WARRANTY; without even the implied warranty of
 * MERCHANTABILITY or FITNESS FOR A PARTICULAR PURPOSE.  See the
 * GNU General Public License for more details.
 */

&mdss_mdp {
	dsi_ft8613_720_1440p_vid: qcom,mdss_dsi_ft8613_720_1440p_video {
		qcom,mdss-dsi-panel-name = "ft8613 720 1440p video mode dsi panel";
		qcom,mdss-dsi-panel-controller = <&mdss_dsi0>;
		qcom,mdss-dsi-panel-destination = "display_1";
		qcom,mdss-dsi-panel-type = "dsi_video_mode";
		qcom,mdss-dsi-panel-framerate = <60>;
		qcom,mdss-dsi-virtual-channel-id = <0>;
		qcom,mdss-dsi-stream = <0>;
		qcom,mdss-dsi-panel-width = <720>;
		qcom,mdss-dsi-panel-height = <1440>;
		qcom,mdss-dsi-h-front-porch = <106>;
		qcom,mdss-dsi-h-back-porch = <106>;
		qcom,mdss-dsi-h-pulse-width = <24>;
		qcom,mdss-dsi-h-sync-skew = <0>;
		qcom,mdss-dsi-v-back-porch = <24>;
		qcom,mdss-dsi-v-front-porch = <24>;
		qcom,mdss-dsi-v-pulse-width = <4>;
		qcom,mdss-dsi-h-left-border = <0>;
		qcom,mdss-dsi-h-right-border = <0>;
		qcom,mdss-dsi-v-top-border = <0>;
		qcom,mdss-dsi-v-bottom-border = <0>;
		qcom,mdss-dsi-bpp = <24>;
		qcom,mdss-dsi-underflow-color = <0xff>;
		qcom,mdss-dsi-border-color = <0>;
		qcom,mdss-dsi-h-sync-pulse = <1>;
		qcom,mdss-dsi-traffic-mode = "burst_mode";
		qcom,mdss-dsi-bllp-eof-power-mode;
		qcom,mdss-dsi-bllp-power-mode;
		qcom,mdss-dsi-lane-map = "lane_map_0123";
		qcom,mdss-dsi-lane-0-state;
		qcom,mdss-dsi-lane-1-state;
		qcom,mdss-dsi-lane-2-state;
		qcom,mdss-dsi-lane-3-state;
		qcom,mdss-dsi-panel-timings = [72 20 14 00 46 4A 1A 24 18 03 04 00];
		qcom,mdss-dsi-t-clk-post = <4>;
		qcom,mdss-dsi-t-clk-pre = <29>;
		qcom,mdss-dsi-bl-min-level = <1>;
		qcom,mdss-dsi-bl-max-level = <4095>;
		qcom,mdss-dsi-dma-trigger = "trigger_sw";
		qcom,mdss-dsi-mdp-trigger = "none";
		qcom,mdss-dsi-on-command = [
			39 01 00 00 00 00 02 00 00
			39 01 00 00 00 00 04 FF 87 16 01
			39 01 00 00 00 00 02 00 80
			39 01 00 00 00 00 03 FF 87 16
			39 01 00 00 00 00 02 00 80
			39 01 00 00 00 00 10 C0 00 B2 00 10 10 00 B2 10 10 00 B2 00 10 10 00
			39 01 00 00 00 00 02 00 80
			39 01 00 00 00 00 02 F3 70
			39 01 00 00 00 00 02 00 A0
			39 01 00 00 00 00 08 C0 0B 01 01 01 01 26 0C
			39 01 00 00 00 00 02 00 D0
			39 01 00 00 00 00 08 C0 0B 01 01 01 01 26 0C
			39 01 00 00 00 00 02 00 80
			39 01 00 00 00 00 0D C2 84 00 00 81 83 00 00 81 85 00 30 B7
			39 01 00 00 00 00 02 00 B0
			39 01 00 00 00 00 10 C2 84 01 00 07 88 83 02 00 07 88 82 03 00 07 88
			39 01 00 00 00 00 02 00 C0
			39 01 00 00 00 00 06 C2 81 04 00 07 88
			39 01 00 00 00 00 02 00 DA 
			39 01 00 00 00 00 03 C2 33 33
			39 01 00 00 00 00 02 00 C5
			39 01 00 00 00 00 06 C2 81 03 00 B4 00
			39 01 00 00 00 00 02 00 AA
			39 01 00 00 00 00 03 C3 99 9C
			39 01 00 00 00 00 02 00 ac
			39 01 00 00 00 00 02 C3 99
			39 01 00 00 00 00 02 00 82
			39 01 00 00 00 00 04 A5 44 04 0C
			39 01 00 00 00 00 02 00 87
			39 01 00 00 00 00 05 A5 00 07 77 77
			39 01 00 00 00 00 02 00 88
			39 01 00 00 00 00 03 C3 22 22
			39 01 00 00 00 00 02 00 98
			39 01 00 00 00 00 03 C3 22 22
			39 01 00 00 00 00 02 00 80
			39 01 00 00 00 00 0A CE 25 00 78 00 78 FF 00 00 05
			39 01 00 00 00 00 02 00 90
			39 01 00 00 00 00 09 CE 00 5C 06 CE 00 5C 00 00
			39 01 00 00 00 00 02 00 A0
			39 01 00 00 00 00 09 CE 00 05 01 01 01 01 3F 0A
			39 01 00 00 00 00 02 00 B0
			39 01 00 00 00 00 07 CE 00 00 60 60 00 60
			39 01 00 00 00 00 02 00 80
			39 01 00 00 00 00 0D CC 02 03 06 07 08 09 0A 18 22 22 22 22
			39 01 00 00 00 00 02 00 90
			39 01 00 00 00 00 0D CC 03 02 09 08 07 06 19 0A 22 22 22 22 
			39 01 00 00 00 00 02 00 A0
			39 01 00 00 00 00 10 CC 1A 1B 1C 1D 1E 1F 18 19 20 21 04 14 15 0A 0A
			39 01 00 00 00 00 02 00 B0
			39 01 00 00 00 00 06 CC 22 22 22 22 22
			39 01 00 00 00 00 02 00 80
			39 01 00 00 00 00 09 CB 0f C0 00 3F 00 C0 00 00
			39 01 00 00 00 00 02 00 90
			39 01 00 00 00 00 10 CB 00 00 00 00 00 00 00 00 00 00 00 00 00 00 00
			39 01 00 00 00 00 02 00 A0
			39 01 00 00 00 00 10 CB 00 00 00 00 00 00 00 00 00 00 00 00 00 00 00
			39 01 00 00 00 00 02 00 B0
			39 01 00 00 00 00 03 CB 00 00
			39 01 00 00 00 00 02 00 C0
			39 01 00 00 00 00 10 CB 05 05 05 05 05 05 05 05 00 00 00 00 05 05 05
			39 01 00 00 00 00 02 00 D0
			39 01 00 00 00 00 10 CB 00 00 00 05 05 05 05 05 00 00 05 0A 00 00 00
			39 01 00 00 00 00 02 00 E0
			39 01 00 00 00 00 03 CB 00 00
			39 01 00 00 00 00 02 00 F0
			39 01 00 00 00 00 09 CB 0F C0 00 3F 00 C0 00 00
			39 01 00 00 00 00 02 00 80
			39 01 00 00 00 00 10 CD 1B 1B 19 01 04 06 08 07 18 17 03 05 1A 22 0F
			39 01 00 00 00 00 02 00 90
			39 01 00 00 00 00 04 CD 0E 0D 22
			39 01 00 00 00 00 02 00 A0
			39 01 00 00 00 00 10 CD 1B 1B 19 02 05 03 08 07 18 17 06 04 1A 22 0F
			39 01 00 00 00 00 02 00 B0
			39 01 00 00 00 00 04 CD 0E 0D 22
			39 01 00 00 00 00 02 00 81
			39 01 00 00 00 00 0D F3 08 C1 40 08 C1 40 00 12 00 00 12 00
			39 01 00 00 00 00 02 00 80
			39 01 00 00 00 00 0b C5 00 C1 DD c4 14 1e 00 55 50 05
			39 01 00 00 00 00 02 00 90
			39 01 00 00 00 00 0b C5 77 1e 14 00 88 10 4C 53 55 50
			39 01 00 00 00 00 02 00 00
			39 01 00 00 00 00 03 D8 31 31
			39 01 00 00 00 00 02 00 00
			39 01 00 00 00 00 19 E1 00 07 1B 2e 3A 47 59 68 6e 77 80 8A 6e 66 63 5C 4e 43 35 2C 23 15 08 07
			39 01 00 00 00 00 02 00 00
			39 01 00 00 00 00 19 E2 00 07 1B 2e 3A 47 59 68 6e 77 80 8A 6e 66 63 5C 4e 43 35 2C 23 15 08 07
			39 01 00 00 00 00 02 00 C0
			39 01 00 00 00 00 03 C0 11 11
			39 01 00 00 00 00 02 00 8D
			39 01 00 00 00 00 02 F5 21
			39 01 00 00 00 00 02 00 00
			39 01 00 00 00 00 05 2A 00 00 02 CF
			39 01 00 00 00 00 02 00 00
			39 01 00 00 00 00 05 2B 00 00 05 9F
			39 01 00 00 00 00 02 00 A0
			39 01 00 00 00 00 08 B3 03 02 D0 05 A0 00 58
			39 01 00 00 00 00 02 00 81
			39 01 00 00 00 00 03 CF 05 04
			39 01 00 00 00 00 02 00 84
			39 01 00 00 00 00 03 CF 05 04
			39 01 00 00 00 00 02 00 C3
			39 01 00 00 00 00 02 F5 26
			39 01 00 00 00 00 02 00 C7
			39 01 00 00 00 00 02 F5 26
			39 01 00 00 00 00 02 00 D3
			39 01 00 00 00 00 02 F5 26
			39 01 00 00 00 00 02 00 D7
			39 01 00 00 00 00 02 F5 26
			39 01 00 00 00 00 02 00 95
			39 01 00 00 00 00 02 F5 26
			39 01 00 00 00 00 02 00 98
			39 01 00 00 00 00 02 F5 26
			39 01 00 00 00 00 02 00 B1
			39 01 00 00 00 00 02 F5 21
			39 01 00 00 00 00 02 35 00
			39 01 00 00 00 00 02 00 00
			39 01 00 00 00 00 04 FF 00 00 00
			39 01 00 00 00 00 02 00 80
			39 01 00 00 00 00 03 FF 00 00 05 01 00 00 64 00 02 11 00 05 01 00 00 14 00 02 29 00];
		qcom,mdss-dsi-off-command = [
			39 01 00 00 00 00 02 00 00
			39 01 00 00 00 00 04 FF 87 16 01
			39 01 00 00 00 00 02 00 80
			39 01 00 00 00 00 03 FF 87 16
			39 01 00 00 00 00 02 00 EA
			39 01 00 00 00 00 02 F5 01
			39 01 00 00 0A 00 02 28 00
			39 01 00 00 78 00 02 10 00
			39 01 00 00 00 00 02 00 00
			39 01 00 00 00 00 05 F7 5A A5 87 16];
		qcom,mdss-dsi-on-command-state = "dsi_lp_mode";
		qcom,mdss-dsi-off-command-state = "dsi_lp_mode";
		qcom,esd-check-enabled;
		qcom,mdss-dsi-panel-status-check-mode = "bta_check";
		qcom,mdss-dsi-bl-pmic-control-type = "bl_ctrl_wled";
		qcom,mdss-dsi-lp11-init;
		qcom,mdss-dsi-reset-sequence = <1 1>, <0 5>, <1 20>;
		qcom,mdss-dsi-tx-eot-append;
		qcom,mdss-pan-physical-width-dimension = <68>;
		qcom,mdss-pan-physical-height-dimension = <136>;
		qcom,panel-supply-entries = <&dsi_panel_pwr_supply>;
	};
};
